## docs/lvgl-n1.defconfig
```kconfig
CONFIG_LV_USE_CLIB_MALLOC=y
CONFIG_LV_USE_CLIB_STRING=y
CONFIG_LV_USE_CLIB_SPRINTF=y
CONFIG_LV_OS_PTHREAD=y
CONFIG_LV_COLOR_DEPTH_32=y
CONFIG_LV_DEF_REFR_PERIOD=33
CONFIG_LV_USE_SDL=y
# CONFIG_LV_SDL_AUTO_BACKEND is not set
CONFIG_LV_SDL_BUF_COUNT=2
CONFIG_LV_USE_LOG=y
CONFIG_LV_LOG_PRINTF=y
CONFIG_LV_USE_DEMO_WIDGETS=y
# CONFIG_LV_BUILD_EXAMPLES is not set
```
